## kernel-4.9-lc/drivers/misc/mediatek/sensors-1.0/alsps/tmd2771/Kconfig
```kconfig
config MTK_TMD2771
	bool "TMD2771 for MediaTek package"
	help
	It support different type sensor
	in this platform. If this option
	is set, it will support ambient
	and light sensor TMD2771.
```
